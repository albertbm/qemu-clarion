## hw/sd/Kconfig
```kconfig
config PL181
    bool
    select SD

config SSI_SD
    bool
    depends on SSI
    select SD

config SD
    bool

config SDHCI
    bool
    select SD

config SDHCI_PCI
    bool
    default y if PCI_DEVICES
    depends on PCI
    select SDHCI

config CADENCE_SDHCI
    bool
    select SDHCI

config AXIADO_SDHCI
    bool
    select SDHCI

config RENESAS_SDHI
    bool
    select SD
    # передача даних іде через HPB-DMAC плати (див. renesas_sdhi.c)
    select CLARION_HPBDMA
```
